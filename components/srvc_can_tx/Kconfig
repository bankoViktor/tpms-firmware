## components/srvc_can_tx/Kconfig
```kconfig
menu "CAN transmitter service"

    config SRVC_CAN_TX_IO_NUM
        int "CAN TX I/O number"
        default 17
        help
            Number of pin for CAN (TWAI) TX output.
    
    config SRVC_CAN_RX_IO_NUM
        int "CAN RX I/O number"
        default 18
        help
            Number of pin for CAN (TWAI) RX input.

    config SRVC_CAN_INTERVAL_MS
        int "CAN TX interval in ms"
        default 100
        help
            CAN transmission interval in ms.

    config SRVC_CAN_TIMEOUT_MS
        int "CAN TX timeout in ms"
        default 1000
        help
            CAN transmission timeout in ms.

    config SRVC_CAN_TASK_PRIORITY
        int "CAN TX task priority"
        default 4
        help
            CAN transmission task priority.

    config SRVC_CAN_TASK_STACK_DEPTH
        int "CAN TX task stack depth"
        default 4096
        help
            CAN transmission task stack depth in butes.
    
endmenu
```

## components/srvc_uhf_rx/Kconfig
```kconfig
menu "UHF receiver service"

    config SRVC_UHF_SPI_HOST_NUM
        int "UHF SPI host number"
        default 1
        help
            Number of the SPI host.
    
    config SRVC_UHF_SPI_MOSI_IO_NUM
        int "UHF SPI MOSI I/O number"
        default 27
        help
            Number of pin for SPI MOSI I/O.

    config SRVC_UHF_SPI_MISO_IO_NUM
        int "UHF SPI MISO I/O number"
        default 26
        help
            Number of pin for SPI MISO I/O.

    config SRVC_UHF_SPI_CLK_IO_NUM
        int "UHF SPI CLK I/O number"
        default 14
        help
            Number of pin for SPI CLK I/O.

    config SRVC_UHF_CS_IO_NUM
        int "UHF CS I/O number"
        default 12
        help
            Number of pin for chip select output.

    config SRVC_UHF_IRQ_IO_NUM
        int "UHF IRQ I/O number"
        default 13
        help
            Number of pin for external interrupt input.

    config SRVC_UHF_INTERVAL_MS
        int "UHF interval in ms"
        default 50
        help
            UHF receiving interval in ms.

    config SRVC_UHF_TASK_PRIORITY
        int "UHF task priority"
        default 5
        help
            UHF receiving task priority.

    config SRVC_UHF_TASK_STACK_DEPTH
        int "UHF task stack depth"
        default 4096
        help
            UHF receiving task stack depth in butes.
    
endmenu
```

## components/srvc_wifi_softap/Kconfig
```kconfig
menu "Wi-Fi AP settings"

    config SRVC_WIFI_SOFTAP_DEF_SSID
        string "Default AP name"
        default "TPMS"
        help
            Default network name of the created Wi-Fi Access Point.
    
    config SRVC_WIFI_SOFTAP_DEF_PW
        string "Default AP password"
        default "12345678"
        help
            Default password of the created Wi-Fi Access Point (8 character min.).

    config SRVC_WIFI_SOFTAP_MAX_CONN
        int "AP max simultaneous connections"
        default 4
        help
            Maximum number of simultaneous connections.

    config SRVC_WIFI_SOFTAP_PW_SUPPRESS_IO_NUM
        int "AP password depress input number"
        default 8
        help
            Number of a input pin for Wi-Fi password suppression of the Wi-Fi Access Point (-1 - not use).
    
endmenu
```
